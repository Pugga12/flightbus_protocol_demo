## CMakeLists.txt
```
cmake_minimum_required(VERSION 3.20.0)

find_package(Zephyr REQUIRED HINTS $ENV{ZEPHYR_BASE})
project(flightbus_demo_cdc_acm)
set(SOURCE_FILES
        ${CMAKE_SOURCE_DIR}/src/main.cpp
        ${CMAKE_SOURCE_DIR}/src/protobufs/protobuf_util.cpp
        ${CMAKE_SOURCE_DIR}/src/devices/uart/protobuf_processor_uart.cpp
        ${CMAKE_SOURCE_DIR}/src/flightbus-burst/burst-formats.cpp
        ${CMAKE_SOURCE_DIR}/src/flightbus-burst/burst.cpp
)

# primary interface selection
if (CONFIG_FLIGHTBUS_CDC_ACM)
    target_sources(app PRIVATE src/devices/uart/cdc-acm/uart_cdc_acm.c)
    target_sources(app PRIVATE src/devices/uart/cdc-acm/UartCdcAcm.cpp)
elseif (CONFIG_FLIGHTBUS_NATIVE_UART)
    target_sources(app PRIVATE src/devices/uart/native-sim/i_uart_generic.c)
    target_sources(app PRIVATE src/devices/uart/native-sim/UartGeneric.cpp)
endif ()
target_sources(app PRIVATE ${SOURCE_FILES})

list(APPEND CMAKE_MODULE_PATH ${ZEPHYR_BASE}/modules/nanopb)
include(nanopb)
set(CMAKE_C_STANDARD 17)
set(CMAKE_CXX_STANDARD_REQUIRED ON)
zephyr_nanopb_sources(app src/protobufs/flightbus_message.proto)
zephyr_include_directories(src)
enable_language(CXX)
```

## Kconfig
```
menu "FlightBus Interface Configuration"

choice
    prompt "Primary interface type"
    help
        The primary interface is the device (usually serial) where messages are sent and recieved from the simulator and other FlightBUS protocol devices
    config FLIGHTBUS_CDC_ACM
        bool "CDC-ACM UART"
        select USB_CDC_ACM
        select SERIAL
        select UART_INTERRUPT_DRIVEN
	select LOG_BACKEND_UART
        help
          Enables the FlightBus CDC-ACM UART interface for receiving FlightBus messages over USB UART

    config FLIGHTBUS_NATIVE_UART
        bool "Native TTY UART (or UART0)"
        select SERIAL
	select UART_INTERRUPT_DRIVEN
	select LOG_BACKEND_UART
        help
            Enables the FlightBus native PTY interface for receiving FlightBus messages in the native simulator
endchoice

config FLIGHTBUS_PACKET_DBG_OUTPUT
    bool "Print decoded messages to UART interface"
    default n
    help
      Prints the decoded data from the protobuf messages sent over the wire. 
      This outputs over the Logging interface, usually uart0 (not the CDC-ACM interface)

config FLIGHTBUS_UART_MAX_MSG_SIZE
    int "Max size of UART dynamic message buffer"
    default 256
    help
        The max size of the dynamic packet buffer used for decoding protobuf data from the UART interface.

config FLIGHTBUS_BURST_PROTOCOL
    bool "[EXPERIMENTAL] Use new FlightBus Burst Messaging System"
    default n

endmenu

source "Kconfig.zephyr"
```

## prj.conf
```kconfig
CONFIG_CONSOLE=y
CONFIG_STDOUT_CONSOLE=y
CONFIG_USB_DEVICE_STACK=y
CONFIG_USB_DEVICE_PRODUCT="FlightBUS CDC-ACM Device"
CONFIG_USB_DEVICE_MANUFACTURER="FlightBUS"
CONFIG_USB_DEVICE_PID=0x0001
CONFIG_USB_DEVICE_SN="fb-001(cdc-acm)"
CONFIG_LOG=y
CONFIG_USB_DRIVER_LOG_LEVEL_ERR=y
CONFIG_USB_DEVICE_LOG_LEVEL_ERR=y
CONFIG_UART_LINE_CTRL=y
CONFIG_USB_DEVICE_INITIALIZE_AT_BOOT=n
CONFIG_LOG_DEFAULT_LEVEL=3
CONFIG_NANOPB=y
CONFIG_HEAP_MEM_POOL_SIZE=4096
CONFIG_FLIGHTBUS_NATIVE_UART=y
CONFIG_UART_CONSOLE=y
CONFIG_UART_INTERRUPT_DRIVEN=y
CONFIG_SERIAL=y

CONFIG_CPP=y
CONFIG_REQUIRES_FULL_LIBCPP=y
CONFIG_CRC=y
```

## boards/arduino_nano_33_ble.overlay
```dts
&zephyr_udc0 {
	cdc_acm_uart0 {
		compatible = "zephyr,cdc-acm-uart";
		label = "Zephyr USB CDC-ACM";
	};
};
```

## boards/native_sim.overlay
```dts
&uart0 {
	compatible = "zephyr,native-tty-uart";
	status = "okay";
	current-speed = <115200>;
	serial-port = "/tmp/ttySIM0";
};
```

## src/main.cpp
```c
//
// Created by adama on 3/23/25.
//
#include <zephyr/kernel.h>
#include <zephyr/drivers/uart.h>
#include <zephyr/device.h>
#include "devices/uart/protobuf_processor_uart.hpp"
#ifdef CONFIG_FLIGHTBUS_CDC_ACM
#include <devices/uart/cdc-acm/UartCdcAcm.hpp>
#elif defined(CONFIG_FLIGHTBUS_NATIVE_UART)
#include <devices/uart/native-sim/UartGeneric.hpp>
#endif

int main(void) {
    const struct device *uart_dev = nullptr;
    static UartBase *uart_wrapper = nullptr;

    #ifdef CONFIG_FLIGHTBUS_CDC_ACM
    uart_dev = DEVICE_DT_GET_ONE(zephyr_cdc_acm_uart);
    static UartCdcAcm uart_cdc_acm(uart_dev, false);
    uart_cdc_acm.start();
    uart_wrapper = &uart_cdc_acm;
    #elif defined(CONFIG_FLIGHTBUS_NATIVE_UART)
    uart_dev = DEVICE_DT_GET(DT_NODELABEL(uart1));
    static UartGeneric uart_generic(uart_dev, false);
    uart_generic.start();
    uart_wrapper = &uart_generic;
    #endif

    if (uart_wrapper) {
        start_protobuf_processor_uart(uart_wrapper);
    }

    return 0;
}
```
